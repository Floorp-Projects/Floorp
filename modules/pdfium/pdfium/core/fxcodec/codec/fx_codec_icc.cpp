// Copyright 2014 PDFium Authors. All rights reserved.
// Use of this source code is governed by a BSD-style license that can be
// found in the LICENSE file.

// Original code copyright 2014 Foxit Software Inc. http://www.foxitsoftware.com

#include "core/fxcodec/fx_codec.h"
#include "third_party/lcms2-2.6/include/lcms2.h"

struct CLcmsCmm {
  cmsHTRANSFORM m_hTransform;
  int m_nSrcComponents;
  int m_nDstComponents;
  bool m_bLab;
};
bool CheckComponents(cmsColorSpaceSignature cs, int nComponents, bool bDst) {
  if (nComponents <= 0 || nComponents > 15) {
    return false;
  }
  switch (cs) {
    case cmsSigLabData:
      if (nComponents < 3) {
        return false;
      }
      break;
    case cmsSigGrayData:
      if (bDst && nComponents != 1) {
        return false;
      }
      if (!bDst && nComponents > 2) {
        return false;
      }
      break;
    case cmsSigRgbData:
      if (bDst && nComponents != 3) {
        return false;
      }
      break;
    case cmsSigCmykData:
      if (bDst && nComponents != 4) {
        return false;
      }
      break;
    default:
      if (nComponents != 3) {
        return false;
      }
      break;
  }
  return true;
}

void* IccLib_CreateTransform(const unsigned char* pSrcProfileData,
                             uint32_t dwSrcProfileSize,
                             uint32_t& nSrcComponents,
                             const unsigned char* pDstProfileData,
                             uint32_t dwDstProfileSize,
                             int32_t nDstComponents,
                             int intent,
                             uint32_t dwSrcFormat = Icc_FORMAT_DEFAULT,
                             uint32_t dwDstFormat = Icc_FORMAT_DEFAULT) {
  nSrcComponents = 0;
  cmsHPROFILE srcProfile =
      cmsOpenProfileFromMem((void*)pSrcProfileData, dwSrcProfileSize);
  if (!srcProfile)
    return nullptr;

  cmsHPROFILE dstProfile;
  if (!pDstProfileData && dwDstProfileSize == 0 && nDstComponents == 3) {
    dstProfile = cmsCreate_sRGBProfile();
  } else {
    dstProfile =
        cmsOpenProfileFromMem((void*)pDstProfileData, dwDstProfileSize);
  }
  if (!dstProfile) {
    cmsCloseProfile(srcProfile);
    return nullptr;
  }
  int srcFormat;
  bool bLab = false;
  cmsColorSpaceSignature srcCS = cmsGetColorSpace(srcProfile);

  nSrcComponents = cmsChannelsOf(srcCS);
  // According to PDF spec, number of components must be 1, 3, or 4.
  if (nSrcComponents != 1 && nSrcComponents != 3 && nSrcComponents != 4) {
    cmsCloseProfile(srcProfile);
    cmsCloseProfile(dstProfile);
    return nullptr;
  }

  if (srcCS == cmsSigLabData) {
    srcFormat =
        COLORSPACE_SH(PT_Lab) | CHANNELS_SH(nSrcComponents) | BYTES_SH(0);
    bLab = true;
  } else {
    srcFormat =
        COLORSPACE_SH(PT_ANY) | CHANNELS_SH(nSrcComponents) | BYTES_SH(1);
    if (srcCS == cmsSigRgbData && T_DOSWAP(dwSrcFormat)) {
      srcFormat |= DOSWAP_SH(1);
    }
  }
  cmsColorSpaceSignature dstCS = cmsGetColorSpace(dstProfile);
  if (!CheckComponents(dstCS, nDstComponents, true)) {
    cmsCloseProfile(srcProfile);
    cmsCloseProfile(dstProfile);
    return nullptr;
  }

  cmsHTRANSFORM hTransform = nullptr;
  switch (dstCS) {
    case cmsSigGrayData:
      hTransform = cmsCreateTransform(srcProfile, srcFormat, dstProfile,
                                      TYPE_GRAY_8, intent, 0);
      break;
    case cmsSigRgbData:
      hTransform = cmsCreateTransform(srcProfile, srcFormat, dstProfile,
                                      TYPE_BGR_8, intent, 0);
      break;
    case cmsSigCmykData:
      hTransform = cmsCreateTransform(
          srcProfile, srcFormat, dstProfile,
          T_DOSWAP(dwDstFormat) ? TYPE_KYMC_8 : TYPE_CMYK_8, intent, 0);
      break;
    default:
      break;
  }
  if (!hTransform) {
    cmsCloseProfile(srcProfile);
    cmsCloseProfile(dstProfile);
    return nullptr;
  }
  CLcmsCmm* pCmm = new CLcmsCmm;
  pCmm->m_nSrcComponents = nSrcComponents;
  pCmm->m_nDstComponents = nDstComponents;
  pCmm->m_hTransform = hTransform;
  pCmm->m_bLab = bLab;
  cmsCloseProfile(srcProfile);
  cmsCloseProfile(dstProfile);
  return pCmm;
}
void* IccLib_CreateTransform_sRGB(const unsigned char* pProfileData,
                                  uint32_t dwProfileSize,
                                  uint32_t& nComponents,
                                  int32_t intent,
                                  uint32_t dwSrcFormat) {
  return IccLib_CreateTransform(pProfileData, dwProfileSize, nComponents,
                                nullptr, 0, 3, intent, dwSrcFormat);
}
void IccLib_DestroyTransform(void* pTransform) {
  if (!pTransform) {
    return;
  }
  cmsDeleteTransform(((CLcmsCmm*)pTransform)->m_hTransform);
  delete (CLcmsCmm*)pTransform;
}
void IccLib_Translate(void* pTransform,
                      uint32_t nSrcComponents,
                      FX_FLOAT* pSrcValues,
                      FX_FLOAT* pDestValues) {
  if (!pTransform) {
    return;
  }
  CLcmsCmm* p = (CLcmsCmm*)pTransform;
  uint8_t output[4];
  if (p->m_bLab) {
    CFX_FixedBufGrow<double, 16> inputs(nSrcComponents);
    double* input = inputs;
    for (uint32_t i = 0; i < nSrcComponents; i++) {
      input[i] = pSrcValues[i];
    }
    cmsDoTransform(p->m_hTransform, input, output, 1);
  } else {
    CFX_FixedBufGrow<uint8_t, 16> inputs(nSrcComponents);
    uint8_t* input = inputs;
    for (uint32_t i = 0; i < nSrcComponents; i++) {
      if (pSrcValues[i] > 1.0f) {
        input[i] = 255;
      } else if (pSrcValues[i] < 0) {
        input[i] = 0;
      } else {
        input[i] = (int)(pSrcValues[i] * 255.0f);
      }
    }
    cmsDoTransform(p->m_hTransform, input, output, 1);
  }
  switch (p->m_nDstComponents) {
    case 1:
      pDestValues[0] = output[0] / 255.0f;
      break;
    case 3:
      pDestValues[0] = output[2] / 255.0f;
      pDestValues[1] = output[1] / 255.0f;
      pDestValues[2] = output[0] / 255.0f;
      break;
    case 4:
      pDestValues[0] = output[0] / 255.0f;
      pDestValues[1] = output[1] / 255.0f;
      pDestValues[2] = output[2] / 255.0f;
      pDestValues[3] = output[3] / 255.0f;
      break;
  }
}
void IccLib_TranslateImage(void* pTransform,
                           unsigned char* pDest,
                           const unsigned char* pSrc,
                           int32_t pixels) {
  cmsDoTransform(((CLcmsCmm*)pTransform)->m_hTransform, (void*)pSrc, pDest,
                 pixels);
}

CCodec_IccModule::CCodec_IccModule() : m_nComponents(0) {}

CCodec_IccModule::~CCodec_IccModule() {
}
void* CCodec_IccModule::CreateTransform_sRGB(const uint8_t* pProfileData,
                                             uint32_t dwProfileSize,
                                             uint32_t& nComponents,
                                             int32_t intent,
                                             uint32_t dwSrcFormat) {
  return IccLib_CreateTransform_sRGB(pProfileData, dwProfileSize, nComponents,
                                     intent, dwSrcFormat);
}

void CCodec_IccModule::DestroyTransform(void* pTransform) {
  IccLib_DestroyTransform(pTransform);
}
void CCodec_IccModule::Translate(void* pTransform,
                                 FX_FLOAT* pSrcValues,
                                 FX_FLOAT* pDestValues) {
  IccLib_Translate(pTransform, m_nComponents, pSrcValues, pDestValues);
}
void CCodec_IccModule::TranslateScanline(void* pTransform,
                                         uint8_t* pDest,
                                         const uint8_t* pSrc,
                                         int32_t pixels) {
  IccLib_TranslateImage(pTransform, pDest, pSrc, pixels);
}
const uint8_t g_CMYKSamples[81 * 81 * 3] = {
    255, 255, 255, 225, 226, 228, 199, 200, 202, 173, 174, 178, 147, 149, 152,
    123, 125, 128, 99,  99,  102, 69,  70,  71,  34,  30,  31,  255, 253, 229,
    226, 224, 203, 200, 199, 182, 173, 173, 158, 149, 148, 135, 125, 124, 113,
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    0,   0,   0,
};
void AdobeCMYK_to_sRGB1(uint8_t c,
                        uint8_t m,
                        uint8_t y,
                        uint8_t k,
                        uint8_t& R,
                        uint8_t& G,
                        uint8_t& B) {
  int fix_c = c << 8;
  int fix_m = m << 8;
  int fix_y = y << 8;
  int fix_k = k << 8;
  int c_index = (fix_c + 4096) >> 13;
  int m_index = (fix_m + 4096) >> 13;
  int y_index = (fix_y + 4096) >> 13;
  int k_index = (fix_k + 4096) >> 13;
  int pos = (c_index * 9 * 9 * 9 + m_index * 9 * 9 + y_index * 9 + k_index) * 3;
  int fix_r = g_CMYKSamples[pos] << 8;
  int fix_g = g_CMYKSamples[pos + 1] << 8;
  int fix_b = g_CMYKSamples[pos + 2] << 8;
  int c1_index = fix_c >> 13;
  if (c1_index == c_index) {
    c1_index = c1_index == 8 ? c1_index - 1 : c1_index + 1;
  }
  int m1_index = fix_m >> 13;
  if (m1_index == m_index) {
    m1_index = m1_index == 8 ? m1_index - 1 : m1_index + 1;
  }
  int y1_index = fix_y >> 13;
  if (y1_index == y_index) {
    y1_index = y1_index == 8 ? y1_index - 1 : y1_index + 1;
  }
  int k1_index = fix_k >> 13;
  if (k1_index == k_index) {
    k1_index = k1_index == 8 ? k1_index - 1 : k1_index + 1;
  }
  int c1_pos = pos + (c1_index - c_index) * 9 * 9 * 9 * 3;
  int m1_pos = pos + (m1_index - m_index) * 9 * 9 * 3;
  int y1_pos = pos + (y1_index - y_index) * 9 * 3;
  int k1_pos = pos + (k1_index - k_index) * 3;
  int c_r_delta = g_CMYKSamples[pos] - g_CMYKSamples[c1_pos];
  int c_g_delta = g_CMYKSamples[pos + 1] - g_CMYKSamples[c1_pos + 1];
  int c_b_delta = g_CMYKSamples[pos + 2] - g_CMYKSamples[c1_pos + 2];
  int m_r_delta = g_CMYKSamples[pos] - g_CMYKSamples[m1_pos];
  int m_g_delta = g_CMYKSamples[pos + 1] - g_CMYKSamples[m1_pos + 1];
  int m_b_delta = g_CMYKSamples[pos + 2] - g_CMYKSamples[m1_pos + 2];
  int y_r_delta = g_CMYKSamples[pos] - g_CMYKSamples[y1_pos];
  int y_g_delta = g_CMYKSamples[pos + 1] - g_CMYKSamples[y1_pos + 1];
  int y_b_delta = g_CMYKSamples[pos + 2] - g_CMYKSamples[y1_pos + 2];
  int k_r_delta = g_CMYKSamples[pos] - g_CMYKSamples[k1_pos];
  int k_g_delta = g_CMYKSamples[pos + 1] - g_CMYKSamples[k1_pos + 1];
  int k_b_delta = g_CMYKSamples[pos + 2] - g_CMYKSamples[k1_pos + 2];
  int c_rate = (fix_c - (c_index << 13)) * (c_index - c1_index);
  fix_r += c_r_delta * c_rate / 32;
  fix_g += c_g_delta * c_rate / 32;
  fix_b += c_b_delta * c_rate / 32;
  int m_rate = (fix_m - (m_index << 13)) * (m_index - m1_index);
  fix_r += m_r_delta * m_rate / 32;
  fix_g += m_g_delta * m_rate / 32;
  fix_b += m_b_delta * m_rate / 32;
  int y_rate = (fix_y - (y_index << 13)) * (y_index - y1_index);
  fix_r += y_r_delta * y_rate / 32;
  fix_g += y_g_delta * y_rate / 32;
  fix_b += y_b_delta * y_rate / 32;
  int k_rate = (fix_k - (k_index << 13)) * (k_index - k1_index);
  fix_r += k_r_delta * k_rate / 32;
  fix_g += k_g_delta * k_rate / 32;
  fix_b += k_b_delta * k_rate / 32;
  if (fix_r < 0) {
    fix_r = 0;
  }
  if (fix_g < 0) {
    fix_g = 0;
  }
  if (fix_b < 0) {
    fix_b = 0;
  }
  R = fix_r >> 8;
  G = fix_g >> 8;
  B = fix_b >> 8;
}
void AdobeCMYK_to_sRGB(FX_FLOAT c,
                       FX_FLOAT m,
                       FX_FLOAT y,
                       FX_FLOAT k,
                       FX_FLOAT& R,
                       FX_FLOAT& G,
                       FX_FLOAT& B) {
  // Convert to uint8_t with round-to-nearest. Avoid using FXSYS_round because
  // it is incredibly expensive with VC++ (tested on VC++ 2015) because round()
  // is very expensive.
  // The 'magic' value of 0.49999997f, the float that precedes 0.5f, was chosen
  // because it gives identical results to FXSYS_round(). Using the constant
  // 0.5f gives different results (1 instead of 0) for one value, 0.0019607842.
  // That value is close to the cusp but zero is the correct answer, and
  // getting the same answer as before is desirable.
  // All floats from 0.0 to 1.0 were tested and now give the same results.
  const float rounding_offset = 0.49999997f;
  uint8_t c1 = int(c * 255.f + rounding_offset);
  uint8_t m1 = int(m * 255.f + rounding_offset);
  uint8_t y1 = int(y * 255.f + rounding_offset);
  uint8_t k1 = int(k * 255.f + rounding_offset);

  ASSERT(c1 == FXSYS_round(c * 255));
  ASSERT(m1 == FXSYS_round(m * 255));
  ASSERT(y1 == FXSYS_round(y * 255));
  ASSERT(k1 == FXSYS_round(k * 255));

  uint8_t r, g, b;
  AdobeCMYK_to_sRGB1(c1, m1, y1, k1, r, g, b);
  // Multiply by a constant rather than dividing because division is much
  // more expensive.
  R = r * (1.0f / 255);
  G = g * (1.0f / 255);
  B = b * (1.0f / 255);
}
