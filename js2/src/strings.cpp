/* -*- Mode: C++; tab-width: 4; indent-tabs-mode: nil; c-basic-offset: 4 -*-
 *
 * ***** BEGIN LICENSE BLOCK *****
 * Version: MPL 1.1/GPL 2.0/LGPL 2.1
 *
 * The contents of this file are subject to the Mozilla Public License Version
 * 1.1 (the "License"); you may not use this file except in compliance with
 * the License. You may obtain a copy of the License at
 * http://www.mozilla.org/MPL/
 *
 * Software distributed under the License is distributed on an "AS IS" basis,
 * WITHOUT WARRANTY OF ANY KIND, either express or implied. See the License
 * for the specific language governing rights and limitations under the
 * License.
 *
 * The Original Code is the JavaScript 2 Prototype.
 *
 * The Initial Developer of the Original Code is
 * Netscape Communications Corporation.
 * Portions created by the Initial Developer are Copyright (C) 1998
 * the Initial Developer. All Rights Reserved.
 *
 * Contributor(s):
 *
 * Alternatively, the contents of this file may be used under the terms of
 * either the GNU General Public License Version 2 or later (the "GPL"), or
 * the GNU Lesser General Public License Version 2.1 or later (the "LGPL"),
 * in which case the provisions of the GPL or the LGPL are applicable instead
 * of those above. If you wish to allow use of your version of this file only
 * under the terms of either the GPL or the LGPL, and not to allow others to
 * use your version of this file under the terms of the MPL, indicate your
 * decision by deleting the provisions above and replace them with the notice
 * and other provisions required by the GPL or the LGPL. If you do not delete
 * the provisions above, a recipient may use your version of this file under
 * the terms of any one of the MPL, the GPL or the LGPL.
 *
 * ***** END LICENSE BLOCK ***** */

#include <algorithm>
#include "strings.h"

namespace JS = JavaScript;


//
// Unicode UTF-16 characters and strings
//

#ifdef _WIN32 // Microsoft VC6 bug: String constructor and append limited to char16 iterators
// Return a String containing the characters of the null-terminated C string cstr
// (without the trailing null).
JS::String JS::widenCString(const char *cstr)
{
    size_t len = strlen(cstr);
    String s(len, uni::null);
    std::transform(cstr, cstr+len, s.begin(), widen);
    return s;
}


// Widen and append length characters starting at chars to the end of str.
void JS::appendChars(String &str, const char *chars, size_t length)
{
    String::size_type strLen = str.size();
    str.append(length, uni::null);
    std::transform(chars, chars+length, str.begin()+strLen, widen);
}


// Widen and insert length characters starting at chars into the given position of str.
void JS::insertChars(String &str, String::size_type pos, const char *chars, size_t length)
{
    str.insert(pos, length, uni::null);
    std::transform(chars, chars+length, str.begin()+pos, widen);
}
#endif


// Widen and insert the null-terminated string cstr into the given position of str.
void JS::insertChars(String &str, String::size_type pos, const char *cstr)
{
    insertChars(str, pos, cstr, strlen(cstr));
}


// Widen and append the null-terminated string cstr to the end of str.
// Return str.
JS::String &JS::operator+=(String &str, const char *cstr)
{
    appendChars(str, cstr, strlen(cstr));
    return str;
}


// Return the concatenation of str and the null-terminated string cstr.
JS::String JS::operator+(const String &str, const char *cstr)
{
    return str + widenCString(cstr);
}


// Return the concatenation of the null-terminated string cstr and str.
JS::String JS::operator+(const char *cstr, const String &str)
{
    String s = widenCString(cstr);
    s += str;
    return s;
}

// Compare a region of string 1, starting at offset 1 with string 2, offset 2
// for a maximum of count characters and return true or false if the regions match
bool JS::regionMatches(const String &str1, uint32 offset1, const String &str2, uint32 offset2, uint32 count, bool ignoreCase)
{
    if (!ignoreCase) {
        while ((count > 0) && (offset1 < str1.size()) && (offset2 < str2.size())) {
	    if (str1[offset1] != str2[offset2]) {
		break;
	    }
	    offset1++;
	    offset2++;
	    count--;
        }        
        return (count == 0);
    }
    else {
        while ((count > 0) && (offset1 < str1.size()) && (offset2 < str2.size())) {
	    if (toLower(str1[offset1]) != toLower(str2[offset2])) {
		break;
	    }
	    offset1++;
	    offset2++;
	    count--;
        }        
        return (count == 0);
    }
}

// ditto, only string 1 is a char* and offset 1 is zero
bool JS::regionMatches(const char *str1, const String &str2, uint32 offset2, uint32 count, bool ignoreCase)
{
    String s = widenCString(str1);
    return regionMatches(s, 0, str2, offset2, count, ignoreCase);
}



// From java.lang.Character:
//
// The character properties are currently encoded into 32 bits in the
// following manner:
//
// 10 bits      signed offset used for converting case
//  1 bit       if 1, adding the signed offset converts the character to
//              lowercase
//  1 bit       if 1, subtracting the signed offset converts the character to
//              uppercase
//  1 bit       if 1, character has a titlecase equivalent (possibly itself)
//  3 bits      0  May not be part of an identifier
//              1  Format control
//              2  May start or continue a JS identifier (includes $ and _)
//              3  May continue a JS identifier
//              4  Behaves like a white space character (but not line break)
//              5  Behaves like a line break character
//  2 bits      0  this character has no numeric property
//              1  adding the digit offset to the character code and then
//                 masking with 0x1F will produce the desired numeric value
//              2  this character has a "strange" numeric value
//              3  a JS supradecimal digit: adding the digit offset to the
//                 character code, then masking with 0x1F, then adding 10
//                 will produce the desired numeric value
//  5 bits      digit offset
//  4 bits      reserved for future use
//  5 bits      character type


// The X table has 1024 entries for a total of 1024 bytes.
const uint8 JS::CharInfo::x[] = {
      0,   1,   2,   3,   4,   5,   6,   7,  // 0x0000
      8,   9,  10,  11,  12,  13,  14,  15,  // 0x0200
     16,  17,  18,  19,  20,  21,  22,  23,  // 0x0400
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    115, 116,  56, 117, 118, 119, 120, 121   // 0xFE00
};


// The Y table has 7808 entries for a total of 7808 bytes.
const uint8 JS::CharInfo::y[] = {
      0,   0,   0,   0,   0,   0,   0,   0,  //   0
      0,   1,  14,   1,   1,  14,   0,   0,  //   0
      0,   0,   0,   0,   0,   0,   0,   0,  //   0
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     46,  46,  46,  46,  46,  15,  46,  46   // 121
};


// The A table has 124 entries for a total of 496 bytes.
const uint32 JS::CharInfo::a[] = {
    0x0000000F,  //   0   Cc
    0x0004000F,  //   1   Cc, whitespace
    0x0004000C,  //   2   Zs, whitespace
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    0x00000013,  // 122   Cs
    0x00000012   // 123   Co
};


// Return c converted to upper case.  If c cannot be converted to upper case,
// return c unchanged.
char16 JS::toUpper(char16 c)
{
    CharInfo ci(c);
    if (ci.info & 0x00100000)
        c = static_cast<char16>(static_cast<int32>(c) - (static_cast<int32>(ci.info) >> 22));
    return c;
}


// Return c converted to lower case.  If c cannot be converted to lower case,
// return c unchanged.
char16 JS::toLower(char16 c)
{
    CharInfo ci(c);
    if (ci.info & 0x00200000)
        c = static_cast<char16>(static_cast<int32>(c) + (static_cast<int32>(ci.info) >> 22));
    return c;
}


// Return true if c is an ASCII hexadecimal digit, in which case store the
// digit's numeric value in d.
bool JS::isASCIIHexDigit(char16 c, uint &digit)
{
    uint cv = c;

    if (cv < '0')
        return false;
    if (cv <= '9') {
        digit = cv - '0';
        return true;
    }
    cv |= 0x20;
    if (cv >= 'a' && cv <= 'f') {
        digit = cv - 'a' + 10;
        return true;
    }
    return false;
}


// Return str advanced past white space characters, but no further than strEnd.
const char16 *JS::skipWhiteSpace(const char16 *str, const char16 *strEnd)
{
    while (str != strEnd && isSpace(*str))
        str++;
    return str;
}


// Allocate a String in the Arena and register that String so that it is
// deallocated at the same time as the Arena.
// DO NOT CALL DELETE ON THE RESULT!
JS::String &JS::newArenaString(Arena &arena)
{
    String *s = new(arena) String();
    arena.registerDestructor(s);
    return *s;
}

JS::String &JS::newArenaString(Arena &arena, const String &str)
{
    String *s = new(arena) String(str);
    arena.registerDestructor(s);
    return *s;
}
