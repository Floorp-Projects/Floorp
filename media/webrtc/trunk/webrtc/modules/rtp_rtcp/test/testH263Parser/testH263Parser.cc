/*
 *  Copyright (c) 2011 The WebRTC project authors. All Rights Reserved.
 *
 *  Use of this source code is governed by a BSD-style license
 *  that can be found in the LICENSE file in the root of the source
 *  tree. An additional intellectual property rights grant can be found
 *  in the file PATENTS.  All contributing project authors may
 *  be found in the AUTHORS file in the root of the source tree.
 */

#include <cassert>
#include <windows.h>
#include <iostream>
#include <tchar.h>

#include "h263_information.h"

#define TEST_STR "Test H263 parser."
#define TEST_PASSED() std::cerr << TEST_STR << " : [OK]" << std::endl
#define PRINT_LINE std::cout << "------------------------------------------" << std::endl;


void PrintInfo(const H263Info* ptr)
{
    std::cout << "info =    GOBs: {";
    for (int i = 0; i < ptr->numOfGOBs; i++)
    {
        std::cout << ptr->ptrGOBbuffer[i] << " ";
    }
    std::cout << "}" << std::endl;
    std::cout << "          sBit: {";
    for (int i = 0; i < ptr->numOfGOBs; i++)
    {
        std::cout << (int)ptr->ptrGOBbufferSBit[i] << " ";
    }
    std::cout << "}" << std::endl;

    std::cout << "uiH263PTypeFmt: " << (int)ptr->uiH263PTypeFmt << std::endl;
    std::cout << "     codecBits: " << (int)ptr->codecBits << std::endl;
    std::cout << "        pQuant: " << (int)ptr->pQuant << std::endl;
    std::cout << "         fType: " << (int)ptr->fType << std::endl;
    std::cout << "        cpmBit: " << (int)ptr->cpmBit << std::endl;
    std::cout << "     numOfGOBs: " << (int)ptr->numOfGOBs << std::endl;
    std::cout << "      numOfMBs: " << (int)ptr->totalNumOfMBs << std::endl;
    std::cout << "                " <<  std::endl;
};

void PrintMBInfo(
    const H263Info* ptr,
    const H263MBInfo* ptrMB)
{
    std::cout << "        gQuant: {";
    for (int i = 0; i < ptr->numOfGOBs; i++)
    {
        std::cout << (int)ptr->ptrGQuant[i] << " ";
    }
    std::cout << "}" << std::endl;
    std::cout << "                " <<  std::endl;

    std::cout << "MBs:{";
    int k = 0;
    for (int i = 0; i < ptr->numOfGOBs; i++)
    {
        std::cout << " {";
        for (int j = 0; j < ptr->ptrNumOfMBs[i]; j++)
        {
            std::cout << ptrMB->ptrBuffer[k++] << " ";
        }
        std::cout << "}" << std::endl;
    }
    std::cout << "}" << std::endl;
    PRINT_LINE;
};

void ValidateResults(
    const H263Info* ptr,
    const H263Info* ptrRef)
{
    assert(ptr->uiH263PTypeFmt == ptrRef->uiH263PTypeFmt);
    assert(ptr->codecBits      == ptrRef->codecBits);
    assert(ptr->pQuant         == ptrRef->pQuant);
    assert(ptr->fType          == ptrRef->fType);
    assert(ptr->numOfGOBs      == ptrRef->numOfGOBs);
    assert(ptr->totalNumOfMBs  == ptrRef->totalNumOfMBs);
    for (int i = 0; i < ptr->numOfGOBs; i++)
    {
        assert(ptr->ptrGOBbuffer[i]     == ptrRef->ptrGOBbuffer[i]);
        assert(ptr->ptrGOBbufferSBit[i] == ptrRef->ptrGOBbufferSBit[i]);
    }
    PrintInfo(ptr);
}

void ValidateMBResults(
    const H263Info* ptr,
    const H263MBInfo* ptrMB,
    const H263Info* ptrRef,
    bool  printRes = true)
{
    int offset = 0;
    int numBytes = 0;
    for (int i = 0; i < ptr->numOfGOBs; i++)
    {
        offset = ptr->CalculateMBOffset(i+1);
        numBytes += ptrMB->ptrBuffer[offset - 1] / 8;
        int numBytesRem = ptrMB->ptrBuffer[offset - 1] % 8;
        if (numBytesRem)
        {
            numBytes++;
        }
        assert(ptr->ptrGQuant[i] == ptrRef->ptrGQuant[i]);
    }
    assert(ptr->ptrGOBbuffer[ptr->numOfGOBs] == numBytes);
    assert(unsigned int( ptr->totalNumOfMBs) <= ptrMB->bufferSize);
    if (printRes)
    {
        PrintMBInfo(ptr, ptrMB);
    }
}


int _tmain(int argc, _TCHAR* argv[])
{

    std::string str;
    std::cout << "--------------------------------" << std::endl;
    std::cout << "------- Test H.263 Parser ------" << std::endl;
    std::cout << "--------------------------------" << std::endl;
    std::cout << "  "  << std::endl;

    // -----------------------------------------------------
    // Input data - H.263 encoded stream SQCIF (P-frame)
    // -----------------------------------------------------
    const int lengthRefSQCIF = 77;
    const unsigned char encodedStreamSQCIF[lengthRefSQCIF] = {
    0x00, 0x00, 0x81, 0xf6, 0x06, 0x04, 0x3f, 0xb7, 0xbc, 0x00, 0x00, 0x86, 0x23,
    0x5b, 0xdb, 0xdf, 0xb1, 0x93, 0xdb, 0xde, 0xd6, 0xf0, 0x00, 0x00, 0x8a, 0x27,
    0xdb, 0xcf, 0xad, 0xbe, 0x00, 0x00, 0x8e, 0x27, 0xed, 0xef, 0x80, 0x00, 0x00,
    0x92, 0x27, 0x6f, 0x7f, 0x80, 0x00, 0x00, 0x96, 0x20, 0xfc, 0xe2, 0xdb, 0xfe,
    0xb7, 0x7d, 0xea, 0x5f, 0xf8, 0xab, 0xd2, 0xff, 0xf6, 0xc9, 0xe5, 0x5e, 0x97,
    0xf7, 0xff, 0xad, 0x4f, 0x49, 0x3b, 0xff, 0xd6, 0xa6, 0x75, 0x82, 0x60};

    // Expected results
    H263Info infoRefSQCIF;
    infoRefSQCIF.uiH263PTypeFmt = 1;
    infoRefSQCIF.codecBits      = 8;
    infoRefSQCIF.pQuant         = 4;
    infoRefSQCIF.fType          = 1;
    infoRefSQCIF.cpmBit         = 0;
    infoRefSQCIF.numOfGOBs      = 6;
    infoRefSQCIF.totalNumOfMBs  = 8*6;

    infoRefSQCIF.ptrGOBbuffer[0] = 0;  infoRefSQCIF.ptrGOBbufferSBit[0] = 0; infoRefSQCIF.ptrGQuant[0] = 0;
    infoRefSQCIF.ptrGOBbuffer[1] = 9;  infoRefSQCIF.ptrGOBbufferSBit[1] = 0; infoRefSQCIF.ptrGQuant[1] = 4;
    infoRefSQCIF.ptrGOBbuffer[2] = 22; infoRefSQCIF.ptrGOBbufferSBit[2] = 0; infoRefSQCIF.ptrGQuant[2] = 4;
    infoRefSQCIF.ptrGOBbuffer[3] = 30; infoRefSQCIF.ptrGOBbufferSBit[3] = 0; infoRefSQCIF.ptrGQuant[3] = 4;
    infoRefSQCIF.ptrGOBbuffer[4] = 37; infoRefSQCIF.ptrGOBbufferSBit[4] = 0; infoRefSQCIF.ptrGQuant[4] = 4;
    infoRefSQCIF.ptrGOBbuffer[5] = 44; infoRefSQCIF.ptrGOBbufferSBit[5] = 0; infoRefSQCIF.ptrGQuant[5] = 4;

    // ----------------------------------------------------
    // Input data - H.263 encoded stream QCIF (P-frame)
    // ----------------------------------------------------
    const int lengthRefQCIF = 123;
    const unsigned char encodedStreamQCIF[lengthRefQCIF] = {
    0x00, 0x00, 0x81, 0x02, 0x0a, 0x04, 0x3f, 0xf8, 0x00, 0x00, 0x86, 0x27, 0x8b,
    0xc6, 0x9f, 0x17, 0x9c, 0x00, 0x00, 0x8a, 0x20, 0xbc, 0x22, 0xf8, 0x5f, 0x46,
    0x03, 0xc1, 0x77, 0x15, 0xe0, 0xb8, 0x38, 0x3f, 0x05, 0xa0, 0xbf, 0x8f, 0x00,
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    0x92, 0x4c, 0xdb, 0x6d, 0x69, 0xc0};

    // Expected results
    H263Info infoRefQCIF;
    infoRefQCIF.uiH263PTypeFmt = 2;
    infoRefQCIF.codecBits      = 8;
    infoRefQCIF.pQuant         = 4;
    infoRefQCIF.fType          = 1;
    infoRefQCIF.cpmBit         = 0;
    infoRefQCIF.numOfGOBs      = 9;
    infoRefQCIF.totalNumOfMBs  = 11*9;

    infoRefQCIF.ptrGOBbuffer[0] = 0;   infoRefQCIF.ptrGOBbufferSBit[0] = 0; infoRefQCIF.ptrGQuant[0] = 0;
    infoRefQCIF.ptrGOBbuffer[1] = 8;   infoRefQCIF.ptrGOBbufferSBit[1] = 0; infoRefQCIF.ptrGQuant[1] = 4;
    infoRefQCIF.ptrGOBbuffer[2] = 17;  infoRefQCIF.ptrGOBbufferSBit[2] = 0; infoRefQCIF.ptrGQuant[2] = 4;
    infoRefQCIF.ptrGOBbuffer[3] = 38;  infoRefQCIF.ptrGOBbufferSBit[3] = 0; infoRefQCIF.ptrGQuant[3] = 4;
    infoRefQCIF.ptrGOBbuffer[4] = 47;  infoRefQCIF.ptrGOBbufferSBit[4] = 0; infoRefQCIF.ptrGQuant[4] = 4;
    infoRefQCIF.ptrGOBbuffer[5] = 58;  infoRefQCIF.ptrGOBbufferSBit[5] = 0; infoRefQCIF.ptrGQuant[5] = 4;
    infoRefQCIF.ptrGOBbuffer[6] = 63;  infoRefQCIF.ptrGOBbufferSBit[6] = 0; infoRefQCIF.ptrGQuant[6] = 4;
    infoRefQCIF.ptrGOBbuffer[7] = 71;  infoRefQCIF.ptrGOBbufferSBit[7] = 0; infoRefQCIF.ptrGQuant[7] = 4;
    infoRefQCIF.ptrGOBbuffer[8] = 84;  infoRefQCIF.ptrGOBbufferSBit[8] = 0; infoRefQCIF.ptrGQuant[8] = 4;

    // ---------------------------------------------------
    // Input data - H.263 encoded stream CIF (P-frame)
    // ---------------------------------------------------
    const int lengthRefCIF = 212;
    const unsigned char encodedStreamCIF[lengthRefCIF] = {
    0x00, 0x00, 0x82, 0x9a, 0x0e, 0x04, 0x3f, 0xff, 0xff, 0x00, 0x00, 0x86, 0x27,
    0xff, 0xff, 0xe0, 0x00, 0x00, 0x8a, 0x27, 0xff, 0xff, 0xe0, 0x00, 0x00, 0x8e,
    0x27, 0xff, 0xff, 0x6b, 0x09, 0x70, 0x00, 0x00, 0x92, 0x27, 0xff, 0xff, 0xe0,
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    0xb4, 0x9a, 0xe0, 0x62};

    // Expected results
    H263Info infoRefCIF;
    infoRefCIF.uiH263PTypeFmt = 3;
    infoRefCIF.codecBits      = 8;
    infoRefCIF.pQuant         = 4;
    infoRefCIF.fType          = 1;
    infoRefCIF.cpmBit         = 0;
    infoRefCIF.numOfGOBs      = 18;
    infoRefCIF.totalNumOfMBs  = 22*18;

    infoRefCIF.ptrGOBbuffer[0]  = 0;   infoRefCIF.ptrGOBbufferSBit[0]  = 0; infoRefCIF.ptrGQuant[0]  = 0;
    infoRefCIF.ptrGOBbuffer[1]  = 9;   infoRefCIF.ptrGOBbufferSBit[1]  = 0; infoRefCIF.ptrGQuant[1]  = 4;
    infoRefCIF.ptrGOBbuffer[2]  = 16;  infoRefCIF.ptrGOBbufferSBit[2]  = 0; infoRefCIF.ptrGQuant[2]  = 4;
    infoRefCIF.ptrGOBbuffer[3]  = 23;  infoRefCIF.ptrGOBbufferSBit[3]  = 0; infoRefCIF.ptrGQuant[3]  = 4;
    infoRefCIF.ptrGOBbuffer[4]  = 32;  infoRefCIF.ptrGOBbufferSBit[4]  = 0; infoRefCIF.ptrGQuant[4]  = 4;
    infoRefCIF.ptrGOBbuffer[5]  = 39;  infoRefCIF.ptrGOBbufferSBit[5]  = 0; infoRefCIF.ptrGQuant[5]  = 4;
    infoRefCIF.ptrGOBbuffer[6]  = 46;  infoRefCIF.ptrGOBbufferSBit[6]  = 0; infoRefCIF.ptrGQuant[6]  = 4;
    infoRefCIF.ptrGOBbuffer[7]  = 54;  infoRefCIF.ptrGOBbufferSBit[7]  = 0; infoRefCIF.ptrGQuant[7]  = 4;
    infoRefCIF.ptrGOBbuffer[8]  = 63;  infoRefCIF.ptrGOBbufferSBit[8]  = 0; infoRefCIF.ptrGQuant[8]  = 4;
    infoRefCIF.ptrGOBbuffer[9]  = 70;  infoRefCIF.ptrGOBbufferSBit[9]  = 0; infoRefCIF.ptrGQuant[9]  = 4;
    infoRefCIF.ptrGOBbuffer[10] = 90;  infoRefCIF.ptrGOBbufferSBit[10]  = 0; infoRefCIF.ptrGQuant[10]  = 4;
    infoRefCIF.ptrGOBbuffer[11] = 104; infoRefCIF.ptrGOBbufferSBit[11] = 0; infoRefCIF.ptrGQuant[11] = 4;
    infoRefCIF.ptrGOBbuffer[12] = 112; infoRefCIF.ptrGOBbufferSBit[12] = 0; infoRefCIF.ptrGQuant[12] = 4;
    infoRefCIF.ptrGOBbuffer[13] = 120; infoRefCIF.ptrGOBbufferSBit[13] = 0; infoRefCIF.ptrGQuant[13] = 4;
    infoRefCIF.ptrGOBbuffer[14] = 127; infoRefCIF.ptrGOBbufferSBit[14] = 0; infoRefCIF.ptrGQuant[14] = 4;
    infoRefCIF.ptrGOBbuffer[15] = 138; infoRefCIF.ptrGOBbufferSBit[15] = 0; infoRefCIF.ptrGQuant[15] = 4;
    infoRefCIF.ptrGOBbuffer[16] = 151; infoRefCIF.ptrGOBbufferSBit[16] = 0; infoRefCIF.ptrGQuant[16] = 4;
    infoRefCIF.ptrGOBbuffer[17] = 180; infoRefCIF.ptrGOBbufferSBit[17] = 0; infoRefCIF.ptrGQuant[17] = 4;

    // -----------------------------------------------------------------------
    // Input data - H.263 encoded stream QCIF (I-frame). Non byte aligned GOBs
    // -----------------------------------------------------------------------
    const int lengthRefQCIF_N = 2020;
    const unsigned char encodedStreamQCIF_N[lengthRefQCIF_N] = {
    0x00,0x00,0x80,0x06,0x08,0x07,0x34,0xe4,0xf7,0x66,0x75,0x12,0x9b,0x64,0x83,0xe9,0x4c,0xc7,0x3c,0x77,0x83,0xcf,0x67,0x96,
    0xe0,0x06,0x69,0x95,0x70,0x60,0x43,0x53,0x96,0x8a,0xa2,0x9e,0x96,0xf8,0x79,0xf0,0xf2,0xb8,0x30,0x21,0xb0,0x0c,0xc0,0x22,
    0x0e,0x70,0x12,0xb0,0x30,0x21,0x9e,0x03,0x3e,0x02,0x22,0xa8,0x83,0xcf,0x7d,0xe8,0xf3,0x85,0x8d,0x01,0x47,0x29,0x03,0x02,
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    0x38,0x2f,0x73,0x89};

    // Expected results
    H263Info infoRefQCIF_N;
    infoRefQCIF_N.uiH263PTypeFmt = 2;
    infoRefQCIF_N.codecBits      = 0;
    infoRefQCIF_N.pQuant         = 7;
    infoRefQCIF_N.fType          = 0;
    infoRefQCIF_N.cpmBit         = 0;
    infoRefQCIF_N.numOfGOBs      = 9;
    infoRefQCIF_N.totalNumOfMBs  = 11*9;

    infoRefQCIF_N.ptrGOBbuffer[0] = 0;    infoRefQCIF_N.ptrGOBbufferSBit[0] = 0; infoRefQCIF_N.ptrGQuant[0] = 0;
    infoRefQCIF_N.ptrGOBbuffer[1] = 215;  infoRefQCIF_N.ptrGOBbufferSBit[1] = 2; infoRefQCIF_N.ptrGQuant[1] = 7;
    infoRefQCIF_N.ptrGOBbuffer[2] = 456;  infoRefQCIF_N.ptrGOBbufferSBit[2] = 1; infoRefQCIF_N.ptrGQuant[2] = 7;
    infoRefQCIF_N.ptrGOBbuffer[3] = 535;  infoRefQCIF_N.ptrGOBbufferSBit[3] = 5; infoRefQCIF_N.ptrGQuant[3] = 7;
    infoRefQCIF_N.ptrGOBbuffer[4] = 615;  infoRefQCIF_N.ptrGOBbufferSBit[4] = 7; infoRefQCIF_N.ptrGQuant[4] = 7;
    infoRefQCIF_N.ptrGOBbuffer[5] = 925;  infoRefQCIF_N.ptrGOBbufferSBit[5] = 4; infoRefQCIF_N.ptrGQuant[5] = 7;
    infoRefQCIF_N.ptrGOBbuffer[6] = 1133; infoRefQCIF_N.ptrGOBbufferSBit[6] = 1; infoRefQCIF_N.ptrGQuant[6] = 7;
    infoRefQCIF_N.ptrGOBbuffer[7] = 1512; infoRefQCIF_N.ptrGOBbufferSBit[7] = 6; infoRefQCIF_N.ptrGQuant[7] = 7;
    infoRefQCIF_N.ptrGOBbuffer[8] = 1832; infoRefQCIF_N.ptrGOBbufferSBit[8] = 7; infoRefQCIF_N.ptrGQuant[8] = 7;

    // --------------------------------------------------
    // Input data - H.263 encoded stream CIF (I-frame)
    // --------------------------------------------------

    FILE* openFile = fopen("H263Foreman_CIF_Iframe.bin", "rb");

    fseek(openFile, 0, SEEK_END);
    int lengthRefCIF_I = ftell(openFile);
    fseek(openFile, 0, SEEK_SET);

    unsigned char* encodedStreamCIF_I = new unsigned char[lengthRefCIF_I];
    fread(encodedStreamCIF_I, 1, lengthRefCIF_I, openFile);
    fclose(openFile);

    // Expected results
    H263Info infoRefCIF_I;
    infoRefCIF_I.uiH263PTypeFmt = 3;
    infoRefCIF_I.codecBits      = 0;
    infoRefCIF_I.pQuant         = 5;
    infoRefCIF_I.fType          = 0;
    infoRefCIF_I.cpmBit         = 0;
    infoRefCIF_I.numOfGOBs      = 18;
    infoRefCIF_I.totalNumOfMBs  = 22*18;

    infoRefCIF_I.ptrGOBbuffer[0]  = 0;     infoRefCIF_I.ptrGOBbufferSBit[0]  = 0; infoRefCIF_I.ptrGQuant[0]  = 0;
    infoRefCIF_I.ptrGOBbuffer[1]  = 1607;  infoRefCIF_I.ptrGOBbufferSBit[1]  = 0; infoRefCIF_I.ptrGQuant[1]  = 5;
    infoRefCIF_I.ptrGOBbuffer[2]  = 2759;  infoRefCIF_I.ptrGOBbufferSBit[2]  = 0; infoRefCIF_I.ptrGQuant[2]  = 5;
    infoRefCIF_I.ptrGOBbuffer[3]  = 3699;  infoRefCIF_I.ptrGOBbufferSBit[3]  = 0; infoRefCIF_I.ptrGQuant[3]  = 5;
    infoRefCIF_I.ptrGOBbuffer[4]  = 4506;  infoRefCIF_I.ptrGOBbufferSBit[4]  = 0; infoRefCIF_I.ptrGQuant[4]  = 5;
    infoRefCIF_I.ptrGOBbuffer[5]  = 5260;  infoRefCIF_I.ptrGOBbufferSBit[5]  = 0; infoRefCIF_I.ptrGQuant[5]  = 5;
    infoRefCIF_I.ptrGOBbuffer[6]  = 6254;  infoRefCIF_I.ptrGOBbufferSBit[6]  = 0; infoRefCIF_I.ptrGQuant[6]  = 5;
    infoRefCIF_I.ptrGOBbuffer[7]  = 7117;  infoRefCIF_I.ptrGOBbufferSBit[7]  = 0; infoRefCIF_I.ptrGQuant[7]  = 5;
    infoRefCIF_I.ptrGOBbuffer[8]  = 7804;  infoRefCIF_I.ptrGOBbufferSBit[8]  = 0; infoRefCIF_I.ptrGQuant[8]  = 5;
    infoRefCIF_I.ptrGOBbuffer[9]  = 8600;  infoRefCIF_I.ptrGOBbufferSBit[9]  = 0; infoRefCIF_I.ptrGQuant[9]  = 5;
    infoRefCIF_I.ptrGOBbuffer[10]  = 9419; infoRefCIF_I.ptrGOBbufferSBit[10] = 0; infoRefCIF_I.ptrGQuant[10] = 5;
    infoRefCIF_I.ptrGOBbuffer[11] = 10126; infoRefCIF_I.ptrGOBbufferSBit[11] = 0; infoRefCIF_I.ptrGQuant[11] = 5;
    infoRefCIF_I.ptrGOBbuffer[12] = 10723; infoRefCIF_I.ptrGOBbufferSBit[12] = 0; infoRefCIF_I.ptrGQuant[12] = 5;
    infoRefCIF_I.ptrGOBbuffer[13] = 11280; infoRefCIF_I.ptrGOBbufferSBit[13] = 0; infoRefCIF_I.ptrGQuant[13] = 5;
    infoRefCIF_I.ptrGOBbuffer[14] = 11910; infoRefCIF_I.ptrGOBbufferSBit[14] = 0; infoRefCIF_I.ptrGQuant[14] = 5;
    infoRefCIF_I.ptrGOBbuffer[15] = 12430; infoRefCIF_I.ptrGOBbufferSBit[15] = 0; infoRefCIF_I.ptrGQuant[15] = 5;
    infoRefCIF_I.ptrGOBbuffer[16] = 12925; infoRefCIF_I.ptrGOBbufferSBit[16] = 0; infoRefCIF_I.ptrGQuant[16] = 5;
    infoRefCIF_I.ptrGOBbuffer[17] = 13506; infoRefCIF_I.ptrGOBbufferSBit[17] = 0; infoRefCIF_I.ptrGQuant[17] = 5;

    // --------------------------------------------------
    // Input data - H.263 encoded stream CIF (P-frame)
    // --------------------------------------------------

    openFile = fopen("H263Foreman_CIF_Pframe.bin", "rb");

    fseek(openFile, 0, SEEK_END);
    int lengthRefCIF_P = ftell(openFile);
    fseek(openFile, 0, SEEK_SET);

    unsigned char* encodedStreamCIF_P = new unsigned char[lengthRefCIF_P];
    fread(encodedStreamCIF_P, 1, lengthRefCIF_P, openFile);
    fclose(openFile);

    // Expected results
    H263Info infoRefCIF_P;
    infoRefCIF_P.uiH263PTypeFmt = 3;
    infoRefCIF_P.codecBits      = 8;
    infoRefCIF_P.pQuant         = 4;
    infoRefCIF_P.fType          = 1;
    infoRefCIF_P.cpmBit         = 0;
    infoRefCIF_P.numOfGOBs      = 18;
    infoRefCIF_P.totalNumOfMBs  = 22*18;

    infoRefCIF_P.ptrGOBbuffer[0]  = 0;    infoRefCIF_P.ptrGOBbufferSBit[0]  = 0; infoRefCIF_P.ptrGQuant[0]  = 0;
    infoRefCIF_P.ptrGOBbuffer[1]  = 252;  infoRefCIF_P.ptrGOBbufferSBit[1]  = 0; infoRefCIF_P.ptrGQuant[1]  = 5;
    infoRefCIF_P.ptrGOBbuffer[2]  = 482;  infoRefCIF_P.ptrGOBbufferSBit[2]  = 0; infoRefCIF_P.ptrGQuant[2]  = 6;
    infoRefCIF_P.ptrGOBbuffer[3]  = 581;  infoRefCIF_P.ptrGOBbufferSBit[3]  = 0; infoRefCIF_P.ptrGQuant[3]  = 6;
    infoRefCIF_P.ptrGOBbuffer[4]  = 676;  infoRefCIF_P.ptrGOBbufferSBit[4]  = 0; infoRefCIF_P.ptrGQuant[4]  = 7;
    infoRefCIF_P.ptrGOBbuffer[5]  = 756;  infoRefCIF_P.ptrGOBbufferSBit[5]  = 0; infoRefCIF_P.ptrGQuant[5]  = 7;
    infoRefCIF_P.ptrGOBbuffer[6]  = 855;  infoRefCIF_P.ptrGOBbufferSBit[6]  = 0; infoRefCIF_P.ptrGQuant[6]  = 8;
    infoRefCIF_P.ptrGOBbuffer[7]  = 949;  infoRefCIF_P.ptrGOBbufferSBit[7]  = 0; infoRefCIF_P.ptrGQuant[7]  = 9;
    infoRefCIF_P.ptrGOBbuffer[8]  = 1004; infoRefCIF_P.ptrGOBbufferSBit[8]  = 0; infoRefCIF_P.ptrGQuant[8]  = 10;
    infoRefCIF_P.ptrGOBbuffer[9]  = 1062; infoRefCIF_P.ptrGOBbufferSBit[9]  = 0; infoRefCIF_P.ptrGQuant[9]  = 11;
    infoRefCIF_P.ptrGOBbuffer[10] = 1115; infoRefCIF_P.ptrGOBbufferSBit[10] = 0; infoRefCIF_P.ptrGQuant[10] = 11;
    infoRefCIF_P.ptrGOBbuffer[11] = 1152; infoRefCIF_P.ptrGOBbufferSBit[11] = 0; infoRefCIF_P.ptrGQuant[11] = 13;
    infoRefCIF_P.ptrGOBbuffer[12] = 1183; infoRefCIF_P.ptrGOBbufferSBit[12] = 0; infoRefCIF_P.ptrGQuant[12] = 14;
    infoRefCIF_P.ptrGOBbuffer[13] = 1214; infoRefCIF_P.ptrGOBbufferSBit[13] = 0; infoRefCIF_P.ptrGQuant[13] = 15;
    infoRefCIF_P.ptrGOBbuffer[14] = 1257; infoRefCIF_P.ptrGOBbufferSBit[14] = 0; infoRefCIF_P.ptrGQuant[14] = 16;
    infoRefCIF_P.ptrGOBbuffer[15] = 1286; infoRefCIF_P.ptrGOBbufferSBit[15] = 0; infoRefCIF_P.ptrGQuant[15] = 16;
    infoRefCIF_P.ptrGOBbuffer[16] = 1321; infoRefCIF_P.ptrGOBbufferSBit[16] = 0; infoRefCIF_P.ptrGQuant[16] = 16;
    infoRefCIF_P.ptrGOBbuffer[17] = 1352; infoRefCIF_P.ptrGOBbufferSBit[17] = 0; infoRefCIF_P.ptrGQuant[17] = 14;

    //---------------------------------------------------------------
    //---------------------------------------------------------------
    //---------------------------------------------------------------
    // Start test
    const H263Info* ptrInfoSQCIF = NULL;
    const H263MBInfo* ptrMBInfoSQCIF = NULL;
    const H263Info* ptrInfoQCIF = NULL;
    const H263MBInfo* ptrMBInfoQCIF = NULL;
    const H263Info* ptrInfoCIF = NULL;
    const H263MBInfo* ptrMBInfoCIF = NULL;
    const H263Info* ptrInfoQCIF_N = NULL;
    const H263MBInfo* ptrMBInfoQCIF_N = NULL;
    const H263Info* ptrInfoCIF_I = NULL;
    const H263MBInfo* ptrMBInfoCIF_I = NULL;
    const H263Info* ptrInfoCIF_P = NULL;
    const H263MBInfo* ptrMBInfoCIF_P = NULL;
    H263Information h263Information;

    // Input buffer
    const int length = 3000;
    unsigned char* encodedBuffer = new unsigned char[lengthRefCIF_P];

    // Test invalid inputs
    assert(-1 == h263Information.GetInfo(NULL, length, ptrInfoSQCIF));
    assert(-1 == h263Information.GetInfo(encodedBuffer, 0, ptrInfoSQCIF));
    assert(-1 == h263Information.GetInfo(encodedBuffer, length, ptrInfoSQCIF)); // invalid H.263 stream
//    assert(-1 == h263Information.GetInfo(encodedStreamSQCIF, lengthRefSQCIF/2, ptrInfoSQCIF)); // invalid H.263 stream

    assert(-1 == h263Information.GetMBInfo(NULL, length, 0, ptrMBInfoSQCIF));
    assert(-1 == h263Information.GetMBInfo(encodedBuffer, 0, 0, ptrMBInfoSQCIF));
    assert(-1 == h263Information.GetMBInfo(encodedBuffer, length, 0, ptrMBInfoSQCIF));
    assert(-1 == h263Information.GetMBInfo(encodedBuffer, length, -1, ptrMBInfoSQCIF)); // incorrect group number
    assert(-1 == h263Information.GetMBInfo(encodedBuffer, length, 8, ptrMBInfoSQCIF));  // incorrect group number

    // ----------------------------------------------
    // Get info from encoded H.263 stream - SQCIF
    // ----------------------------------------------
    h263Information.Reset();
    assert(0 == h263Information.GetInfo(encodedStreamSQCIF, lengthRefSQCIF, ptrInfoSQCIF));
    ValidateResults(ptrInfoSQCIF, &infoRefSQCIF);

    // Get MB info
    for (int i = 0; i < ptrInfoSQCIF->numOfGOBs; i++)
    {
        assert(0 == h263Information.GetMBInfo(encodedStreamSQCIF, lengthRefSQCIF, i, ptrMBInfoSQCIF));
    }
    ValidateMBResults(ptrInfoSQCIF, ptrMBInfoSQCIF, &infoRefSQCIF);

    // ---------------------------------------------
    // Get info from encoded H.263 stream - QCIF
    // ---------------------------------------------
    h263Information.Reset();
    assert(0 == h263Information.GetInfo(encodedStreamQCIF, lengthRefQCIF, ptrInfoQCIF));
    ValidateResults(ptrInfoQCIF, &infoRefQCIF);

    // Get MB info
    for (int i = 0; i < ptrInfoQCIF->numOfGOBs; i++)
    {
        assert(0 == h263Information.GetMBInfo(encodedStreamQCIF, lengthRefQCIF, i, ptrMBInfoQCIF));
    }
    ValidateMBResults(ptrInfoQCIF, ptrMBInfoQCIF, &infoRefQCIF);

    // --------------------------------------------
    // Get info from encoded H.263 stream - CIF
    // --------------------------------------------
    h263Information.Reset();
    assert(0 == h263Information.GetInfo(encodedStreamCIF, lengthRefCIF, ptrInfoCIF));
    ValidateResults(ptrInfoCIF, &infoRefCIF);

    // Get MB info
    for (int i = 0; i < ptrInfoCIF->numOfGOBs; i++)
    {
        assert(0 == h263Information.GetMBInfo(encodedStreamCIF, lengthRefCIF, i, ptrMBInfoCIF));
    }
    ValidateMBResults(ptrInfoCIF, ptrMBInfoCIF, &infoRefCIF);

    // ----------------------------------------------------------------------
    // Get info from encoded H.263 stream - QCIF - non byte aligned GOBs
    // ----------------------------------------------------------------------
    h263Information.Reset();
    assert(0 == h263Information.GetInfo(encodedStreamQCIF_N, lengthRefQCIF_N, ptrInfoQCIF_N));
    ValidateResults(ptrInfoQCIF_N, &infoRefQCIF_N);

    // Get MB info
    for (int i = 0; i < ptrInfoQCIF_N->numOfGOBs; i++)
    {
        assert(0 == h263Information.GetMBInfo(encodedStreamQCIF_N, lengthRefQCIF_N, i, ptrMBInfoQCIF_N));
    }
    ValidateMBResults(ptrInfoQCIF_N, ptrMBInfoQCIF_N, &infoRefQCIF_N);

    // -------------------------------------------
    // Get info from encoded H.263 stream - CIF
    // -------------------------------------------
    h263Information.Reset();
    assert(0 == h263Information.GetInfo(encodedStreamCIF_I, lengthRefCIF_I, ptrInfoCIF_I));
    ValidateResults(ptrInfoCIF_I, &infoRefCIF_I);

    // Get MB info
    unsigned int start = timeGetTime();
    for (int i = 0; i < ptrInfoCIF_I->numOfGOBs; i++)
    {
        assert(0 == h263Information.GetMBInfo(encodedStreamCIF_I, lengthRefCIF_I, i, ptrMBInfoCIF_I));
    }
    unsigned int endMB = timeGetTime();
    ValidateMBResults(ptrInfoCIF_I, ptrMBInfoCIF_I, &infoRefCIF_I, false);

    std::cout << "I-frame, length: " << lengthRefCIF_I << " bytes. Time: " << endMB - start << " ms." << std::endl;
    PRINT_LINE;

    // -------------------------------------------
    // Get info from encoded H.263 stream - CIF
    // -------------------------------------------
    h263Information.Reset();
    assert(0 == h263Information.GetInfo(encodedStreamCIF_P, lengthRefCIF_P, ptrInfoCIF_P));
    ValidateResults(ptrInfoCIF_P, &infoRefCIF_P);

    // Get MB info
    start = timeGetTime();
    for (int i = 0; i < ptrInfoCIF_P->numOfGOBs; i++)
    {
        assert(0 == h263Information.GetMBInfo(encodedStreamCIF_P, lengthRefCIF_P, i, ptrMBInfoCIF_P));
    }
    endMB = timeGetTime();
    ValidateMBResults(ptrInfoCIF_P, ptrMBInfoCIF_P, &infoRefCIF_P, false);

    std::cout << "P-frame, length:  " << lengthRefCIF_P << " bytes. Time: " << endMB - start << " ms." << std::endl;
    PRINT_LINE;

    delete [] encodedStreamCIF_I;
    delete [] encodedStreamCIF_P;
    delete [] encodedBuffer;

    TEST_PASSED();
    ::Sleep(5000);
    return 0;
}

