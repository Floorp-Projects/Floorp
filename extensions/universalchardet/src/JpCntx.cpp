
#include "nscore.h"
#include "JpCntx.h"

char jp2CharContext[83][83] = 
{ 
{ 0,0,0,2,0,0,0,0,0,0,0,0,0,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1,},
{ 2,4,0,4,0,3,0,4,0,3,4,4,4,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4,},
{ 0,0,1,0,0,0,0,0,0,0,0,0,0,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2,},
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{ 0,4,0,3,0,3,0,3,0,3,5,5,3,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1,},
};

#define MINIMUM_DATA_THRESHOLD  4

void JapaneseContextAnalysis::HandleData(const char* aBuf, PRUint32 aLen)
{
  PRUint32 charLen;
  PRInt32 order;
  PRUint32 i;
  
  if (mDone)
    return;

  for (i = mNeedToSkipCharNum; i < aLen; )
  {
    order = GetOrder(aBuf+i, &charLen);
    i+= charLen;
    if (i > aLen){
      mNeedToSkipCharNum = i - aLen;
      mLastCharOrder = -1;
    }
    else 
    {
      if (order != -1 && mLastCharOrder != -1)
      {
        mTotalRel ++;
        if (mTotalRel > MAX_REL_THRESHOLD)
        {
          mDone = PR_TRUE;
          break;
        }
        mRelSample[jp2CharContext[mLastCharOrder][order]]++;
      }
      mLastCharOrder = order;
    }
  }
  
  return;
}

void JapaneseContextAnalysis::Reset(void)
{
  mTotalRel = 0;
  for (PRUint32 i = 0; i < NUM_OF_CATEGORY; i++)
    mRelSample[i] = 0;
  mNeedToSkipCharNum = 0;
  mLastCharOrder = -1;
  mDone = PR_FALSE;
}
#define DONT_KNOW (float)-1

float  JapaneseContextAnalysis::GetConfidence()
{
  if (mTotalRel > MINIMUM_DATA_THRESHOLD)
    return ((float)(mTotalRel - mRelSample[0]))/mTotalRel;
  else 
    return (float)DONT_KNOW;
}


PRInt32 SJISContextAnalysis::GetOrder(const char* str, PRUint32 *charLen)
{
  if ((unsigned char)*str >= (unsigned char)0x81 && (unsigned char)*str <= (unsigned char)0x9f || 
      (unsigned char)*str >= (unsigned char)0xe0 && (unsigned char)*str <= (unsigned char)0xfc )
      *charLen = 2;
  else 
      *charLen = 1;
  if (*str == '\202' && 
        (unsigned char)*(str+1) >= (unsigned char)0x9f && 
        (unsigned char)*(str+1) <= (unsigned char)0xf1)
    return (unsigned char)*(str+1) - (unsigned char)0x9f;
  else 
    return -1;
}

PRInt32 EUCJPContextAnalysis::GetOrder(const char* str, PRUint32 *charLen)
{
  if ((unsigned char)*str == (unsigned char)0x8e ||
      (unsigned char)*str >= (unsigned char)0xa1 && 
      (unsigned char)*str <= (unsigned char)0xfe)
      *charLen = 2;
  else if ((unsigned char)*str == (unsigned char)0x8f)
    *charLen = 3;
  else
    *charLen = 1;

  if ((unsigned char)*str == (unsigned char)0xa4)
    return (unsigned char)*(str+1) - (unsigned char)0xa1;
  else 
    return -1;
}


