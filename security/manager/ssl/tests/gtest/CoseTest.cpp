/* -*- Mode: C++; tab-width: 2; indent-tabs-mode: nil; c-basic-offset: 2 -*- */
/* This Source Code Form is subject to the terms of the Mozilla Public
 * License, v. 2.0. If a copy of the MPL was not distributed with this
 * file, You can obtain one at http://mozilla.org/MPL/2.0/. */

#include "gtest/gtest.h"

#include <assert.h>
#include <stdint.h>
#include <stdio.h>
#include <cstddef>
#include <memory>

#include <keyhi.h>
#include <nss.h>
#include <pk11pub.h>

#include <pkcs11t.h>
#include <secmodt.h>
#include <cert.h>

#include "ScopedNSSTypes.h"
#include "cosec.h"

namespace mozilla {

// "This is the content."
const uint8_t PAYLOAD[] = { 84,  104, 105, 115, 32,  105, 115, 32,  116, 104,
                            101, 32,  99,  111, 110, 116, 101, 110, 116, 46 };

// This is a COSE signature generated with the cose rust library (see
// third-party/rust/cose). The payload is signed with the P256 key from
// pykey.py.
const uint8_t SIGNATURE[] = {
  0xd8, 0x62, 0x84, 0x59, 0x02, 0xa3, 0xa1, 0x04, 0x82, 0x59, 0x01, 0x4e, 0x30,
  0x82, 0x01, 0x4a, 0x30, 0x81, 0xf1, 0xa0, 0x03, 0x02, 0x01, 0x02, 0x02, 0x14,
  0x5f, 0x3f, 0xae, 0x90, 0x49, 0x30, 0x2f, 0x33, 0x6e, 0x95, 0x23, 0xa7, 0xcb,
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  0x19, 0x00, 0xff, 0x74, 0x40, 0x71, 0x82, 0x65, 0xe9
};

// This is a COSE signature generated with the cose rust library (see
// third-party/rust/cose). The payload is signed twice; with the P256 and the
// RSA key from pykey.py.
const uint8_t SIGNATURE_ES256_PS256[] = {
  0xd8, 0x62, 0x84, 0x59, 0x08, 0x52, 0xa1, 0x04, 0x84, 0x59, 0x01, 0x4e, 0x30,
  0x82, 0x01, 0x4a, 0x30, 0x81, 0xf1, 0xa0, 0x03, 0x02, 0x01, 0x02, 0x02, 0x14,
  0x5f, 0x3f, 0xae, 0x90, 0x49, 0x30, 0x2f, 0x33, 0x6e, 0x95, 0x23, 0xa7, 0xcb,
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  0xff, 0x77, 0x6f, 0x92, 0xea, 0x5d, 0x31, 0xe9, 0x18
};

// The RSA intermediate certificate that issued the EE cert used in the
// signature above. The certificate was generated with pycert.py
const uint8_t RSA_INT[] = {
  0x30, 0x82, 0x02, 0xd0, 0x30, 0x82, 0x01, 0xba, 0xa0, 0x03, 0x02, 0x01, 0x02,
  0x02, 0x14, 0x07, 0x10, 0xaf, 0xc4, 0x1a, 0x3a, 0x56, 0x4f, 0xd8, 0xc2, 0xcc,
  0x46, 0xd7, 0x5b, 0xdf, 0x1c, 0x4e, 0x2f, 0x49, 0x3a, 0x30, 0x0b, 0x06, 0x09,
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  0x61, 0xb0, 0x8d, 0x0d, 0x0c, 0x87, 0xc6, 0x5c, 0x51
};

// The RSA root certificate that issued the RSA intermediate certificate above.
// The certificate was generated with pycert.py
const uint8_t RSA_ROOT[] = {
  0x30, 0x82, 0x02, 0xd1, 0x30, 0x82, 0x01, 0xbb, 0xa0, 0x03, 0x02, 0x01, 0x02,
  0x02, 0x14, 0x29, 0x6c, 0x1a, 0xd8, 0x20, 0xcd, 0x74, 0x6d, 0x4b, 0x00, 0xf3,
  0x16, 0x88, 0xd9, 0x66, 0x87, 0x5f, 0x28, 0x56, 0x6a, 0x30, 0x0b, 0x06, 0x09,
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  0x93, 0x37, 0x80, 0xca, 0xda, 0xf0, 0xef, 0x7d, 0x94, 0xb5
};

// The P256 intermediate certificate that issued the EE cert used in the
// signatures above. The certificate was generated with pycert.py
const uint8_t P256_INT[] = {
  0x30, 0x82, 0x01, 0x48, 0x30, 0x81, 0xf0, 0xa0, 0x03, 0x02, 0x01, 0x02, 0x02,
  0x14, 0x43, 0x63, 0x59, 0xad, 0x04, 0x34, 0x56, 0x80, 0x43, 0xec, 0x90, 0x6a,
  0xd4, 0x10, 0x64, 0x7c, 0x7f, 0x38, 0x32, 0xe2, 0x30, 0x0a, 0x06, 0x08, 0x2a,
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  0x13, 0xa2, 0xf7, 0x78, 0x15, 0x30, 0xa7
};

// The P256 root certificate that issued the P256 intermediate certificate
// above. The certificate was generated with pycert.py
const uint8_t P256_ROOT[] = {
  0x30, 0x82, 0x01, 0x4a, 0x30, 0x81, 0xf1, 0xa0, 0x03, 0x02, 0x01, 0x02, 0x02,
  0x14, 0x5f, 0x3f, 0xae, 0x90, 0x49, 0x30, 0x2f, 0x33, 0x6e, 0x95, 0x23, 0xa7,
  0xcb, 0x23, 0xd7, 0x65, 0x4f, 0xea, 0x3c, 0xf7, 0x30, 0x0a, 0x06, 0x08, 0x2a,
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  0xc8, 0x9f, 0xef, 0xb8, 0x5d, 0xa2, 0x40, 0xd9, 0x8b
};

void
check_hard_coded_certs(const uint8_t** cert_chain,
                       size_t cert_chain_len,
                       const size_t* certs_len)
{
  // Very hacky and fragile check that the intermediate certs are correct.
  switch (cert_chain_len) {
    case 2: {
      const uint8_t* cert = cert_chain[0];
      size_t cert_len = certs_len[0];
      ASSERT_EQ(cert_len, sizeof(P256_ROOT));
      ASSERT_EQ(0, memcmp(cert, P256_ROOT, cert_len));
      cert = cert_chain[1];
      cert_len = certs_len[1];
      ASSERT_EQ(cert_len, sizeof(P256_INT));
      ASSERT_EQ(0, memcmp(cert, P256_INT, cert_len));
      break;
    }
    case 4: {
      const uint8_t* cert = cert_chain[0];
      size_t cert_len = certs_len[0];
      ASSERT_EQ(cert_len, sizeof(P256_ROOT));
      ASSERT_EQ(0, memcmp(cert, P256_ROOT, cert_len));
      cert = cert_chain[1];
      cert_len = certs_len[1];
      ASSERT_EQ(cert_len, sizeof(P256_INT));
      ASSERT_EQ(0, memcmp(cert, P256_INT, cert_len));
      cert = cert_chain[2];
      cert_len = certs_len[2];
      ASSERT_EQ(cert_len, sizeof(RSA_ROOT));
      ASSERT_EQ(0, memcmp(cert, RSA_ROOT, cert_len));
      cert = cert_chain[3];
      cert_len = certs_len[3];
      ASSERT_EQ(cert_len, sizeof(RSA_INT));
      ASSERT_EQ(0, memcmp(cert, RSA_INT, cert_len));
      break;
    }
    default:
      // In this case something went wrong.
      ASSERT_EQ(true, false);
  }
}

/* Verification function called from cose-rust.
 * Returns true if everything goes well and the signature is good, false in any
 * other case. */
bool
verify_callback(const uint8_t* payload,
                size_t payload_len,
                const uint8_t** cert_chain,
                size_t cert_chain_len,
                const size_t* certs_len,
                const uint8_t* ee_cert,
                size_t ee_cert_len,
                const uint8_t* signature,
                size_t signature_len,
                uint8_t signature_algorithm,
                void* ctx)
{
  UniquePK11SlotInfo slot(PK11_GetInternalSlot());
  if (!slot) {
    return false;
  }

  CK_MECHANISM_TYPE mechanism;
  SECOidTag oid;
  uint32_t hash_length;
  SECItem param = { siBuffer, nullptr, 0 };
  CK_RSA_PKCS_PSS_PARAMS rsa_pss_params = { CKM_SHA256, CKG_MGF1_SHA256, SHA256_LENGTH };
  switch (signature_algorithm) {
    case (ES256):
      mechanism = CKM_ECDSA;
      oid = SEC_OID_SHA256;
      hash_length = SHA256_LENGTH;
      break;
    case (PS256):
      mechanism = CKM_RSA_PKCS_PSS;
      oid = SEC_OID_SHA256;
      hash_length = SHA256_LENGTH;
      param = { siBuffer,
                reinterpret_cast<unsigned char*>(&rsa_pss_params),
                sizeof(rsa_pss_params) };
      break;
    default:
      return false;
  }
  check_hard_coded_certs(cert_chain, cert_chain_len, certs_len);

  uint8_t hash_buf[HASH_LENGTH_MAX];
  SECStatus rv = PK11_HashBuf(oid, hash_buf, payload, payload_len);
  if (rv != SECSuccess) {
    return false;
  }
  SECItem hash_item = { siBuffer, hash_buf, hash_length };
  CERTCertDBHandle* db_handle = CERT_GetDefaultCertDB();
  if (!db_handle) {
    return false;
  }
  SECItem der_cert = { siBuffer,
                       const_cast<uint8_t*>(ee_cert),
                       static_cast<unsigned int>(ee_cert_len) };
  UniqueCERTCertificate cert(
    CERT_NewTempCertificate(db_handle, &der_cert, nullptr, false, true));
  if (!cert) {
    return false;
  }
  UniqueSECKEYPublicKey key(CERT_ExtractPublicKey(cert.get()));
  if (!key) {
    return false;
  }
  SECItem signature_item = { siBuffer,
                             const_cast<uint8_t*>(signature),
                             static_cast<unsigned int>(signature_len) };
  rv = PK11_VerifyWithMechanism(
    key.get(), mechanism, &param, &signature_item, &hash_item, nullptr);
  if (rv != SECSuccess) {
    return false;
  }

  return true;
}

class psm_COSE : public ::testing::Test
{
};

TEST_F(psm_COSE, CoseTestingSingleSignature)
{
  SECStatus rv = NSS_NoDB_Init(nullptr);
  ASSERT_EQ(SECSuccess, rv);
  bool result = verify_cose_signature_ffi(PAYLOAD,
                                          sizeof(PAYLOAD),
                                          SIGNATURE,
                                          sizeof(SIGNATURE),
                                          nullptr,
                                          verify_callback);
  ASSERT_TRUE(result);
}

TEST_F(psm_COSE, CoseTestingTwoSignatures)
{
  SECStatus rv = NSS_NoDB_Init(nullptr);
  ASSERT_EQ(SECSuccess, rv);
  bool result = verify_cose_signature_ffi(PAYLOAD,
                                          sizeof(PAYLOAD),
                                          SIGNATURE_ES256_PS256,
                                          sizeof(SIGNATURE_ES256_PS256),
                                          nullptr,
                                          verify_callback);
  ASSERT_TRUE(result);
}

TEST_F(psm_COSE, CoseTestingAlteredPayload)
{
  SECStatus rv = NSS_NoDB_Init(nullptr);
  ASSERT_EQ(SECSuccess, rv);
  uint8_t altered_payload[20] = { 84,  104, 105, 115, 32,  104, 115,
                                  32,  116, 104, 101, 32,  99,  111,
                                  110, 116, 101, 110, 116, 46 };
  bool result = verify_cose_signature_ffi(altered_payload,
                                          sizeof(altered_payload),
                                          SIGNATURE_ES256_PS256,
                                          sizeof(SIGNATURE_ES256_PS256),
                                          nullptr,
                                          verify_callback);
  ASSERT_FALSE(result);
}

} // namespace mozilla
