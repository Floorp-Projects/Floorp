#include "testTypeLib.h"
#include "testTypeInfo.h"

// this file will be generated by the IDL compiler

NS_DEFINE_IID(myLibIID, MY_TYPELIB_IID);
NS_DEFINE_IID(typeLibIID, NS_TYPELIB_IID);
NS_DEFINE_IID(typeInfIID, NS_TYPEINFO_IID);

nsresult testTypeLib::QueryInterface(REFNSIID aIID, void** aInstancePtr)
{
	if (nsTypeLib::QueryInterface(aIID, aInstancePtr) == NS_OK)
		return NS_OK;
	if (aIID.Equals(myLibIID)) {
		*aInstancePtr = (void*)this;
		NS_ADDREF_THIS();
		return NS_OK;
	}
	return NS_NOINTERFACE;
}

testTypeLib::testTypeLib() : nsTypeLib(1)
{
	testTypeInfo* tst = new testTypeInfo(this);
	if (tst->QueryInterface(typeInfIID,(void**)&ti[0]) != NS_OK)
		ti[0] = NULL;
	else 
		kind[0] = TKIND_INTERFACE;
	libattr.guid = myLibIID;
	libattr.lcid = -1;			// niu (not in use)
    libattr.syskind = SYS_WIN32;
    libattr.wMajorVerNum = 1;
    libattr.wMinorVerNum = -1;	// niu
    libattr.wLibFlags = -1;		// niu
}

// this should be kept elsewhere
testTypeLib* testTypeLib::tlib = NULL;

nsresult GetTypeLib(REFNSIID libid, nsITypeLib** lib)
{
	if (testTypeLib::tlib == NULL)
		testTypeLib::tlib = new testTypeLib();
	return testTypeLib::tlib->QueryInterface(typeLibIID, (void**)lib);
}
